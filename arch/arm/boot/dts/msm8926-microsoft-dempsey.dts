/* Copyright (c) 2013, The Linux Foundation. All rights reserved.
 * Copyright (c) 2025, Vicente Iñaki Cortés Cortés.
 *
 * This program is free software; you can redistribute it and/or modify
 * it under the terms of the GNU General Public License version 2 and
 * only version 2 as published by the Free Software Foundation.
 *
 * This program is distributed in the hope that it will be useful,
 * but WITHOUT ANY WARRANTY; without even the implied warranty of
 * MERCHANTABILITY or FITNESS FOR A PARTICULAR PURPOSE.  See the
 * GNU General Public License for more details.
 */

/dts-v1/;
#include "msm8926-microsoft-common.dtsi"

/ {
	model = "Microsoft Lumia 640";
	compatible = "microsoft,dempsey", "qcom,msm8926";
	qcom,msm-id = <200 8 0x20000>,
};

